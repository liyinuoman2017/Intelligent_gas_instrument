/**
*********************************************************************************************************
*                                        
*                                      (c) Copyright 2023-2033
*                                         All Rights Reserved
*
* @File    : 
* @By      : liwei
* @Version : V0.01
* 
*********************************************************************************************************
**/

/*
*********************************************************************************************************
Includes 
*********************************************************************************************************
*/
#include "user_type.h"
#include "display_task.h"
#include "display_bsp.h"

/*
*********************************************************************************************************
Define
*********************************************************************************************************
*/
#define UNIT_C 		(3)
#define UNIT_MG_M3 	(2)
#define UNIT_LEL	(1)
#define UNIT_PPM	(0)

#define SHOW_NUM (3)
/*
*********************************************************************************************************
Typedef
*********************************************************************************************************
*/

/*
*********************************************************************************************************
Variables
*********************************************************************************************************
*/
//显示缓存RAM 1 亮 0 灭 
uint16_t lcd_ram_buff[4]={0,0,0,0}; 
//数值译码     0~9 第10个是空             
const uint8_t value_decode[11]	=	{0xed,0x28,0XB5,0XB9,0X78,0xd9 ,0xdd,0xa8,0xfd,0xf9,0x00};
// 第4位书的数值译码     0~9 第10个是空                     
const uint8_t value_decode_s4[11]	=	{0x7b,0x11,0X5e,0X57,0X35,0x67 ,0x6f,0x51,0x7f,0x77,0x00};
//四个字段的起始位
const uint8_t start_buff[4] ={8,5,2,0};
//三个小数点的起始位
const uint8_t dot_bit[3] ={6,4,1};


//三个用户数据  0 温度  1 CH4  2 C0      
uint16_t user_data[3]={25 ,8 ,100};
//三个用户数据 单位 
const uint8_t user_data_unit[3]={UNIT_C ,UNIT_LEL ,UNIT_PPM};
//三个用户数据 小数点
const uint8_t user_data_dot[3]={4 ,4 ,4};

static uint16_t delay=0;
/*
*********************************************************************************************************
Function 
*********************************************************************************************************
*/
static uint8_t read(uint8_t* stream);
static uint8_t write(uint8_t* stream);
static uint8_t initialization(uint8_t* stream);
static uint8_t interrput(uint8_t* stream);
static uint8_t run(uint8_t* stream);

const application_template_t display_operation=
{
	.read=&read,
	.write=&write,
	.initialization=&initialization,
	.interrput=&interrput,
	.run=&run,
};


/***********************************************************************************************************
* @描述	: 将段码 以2*4 分配到 decode_buff[4] 中
***********************************************************************************************************/
void decode_one_segment(uint8_t decode ,uint16_t *decode_buff, uint8_t start)
{
	for(uint8_t i = 0 ; i < 8 ; i++)
	{
		if((decode&(0x01<<i)) !=  0)
		{
			decode_buff[(i/2)%4] |= 0x0001<<(start+i%2);
		}
		else
		{
			decode_buff[(i/2)%4] &= ~(0x0001<<(start+i%2));
		}
	}
}
/***********************************************************************************************************
* @描述	: 将段码 以2*4 分配到 decode_buff[4] 中 做了首位零屏蔽
***********************************************************************************************************/
void display_value(uint16_t data)
{
	uint16_t value_bit = 1;
	uint16_t display_bit = 1;
	uint8_t i;
	//4位显示一个数
	for( i = 0 ; i < 4 ; i++)
	{
		if(i ==0)
			decode_one_segment(value_decode_s4[(data/value_bit)%10] , lcd_ram_buff, start_buff[i] );
		else
			decode_one_segment(value_decode[(data/value_bit)%10] , lcd_ram_buff, start_buff[i] );
		value_bit = value_bit*10;
	}		
	//首位的零需要去掉 判断数据有几位
	if(data>999)
	{
		display_bit = 4;			
	}
	else if(data>99)
	{
		display_bit = 3;	
	}
	else if(data>9)
	{
		display_bit = 2;	
	}
	else
	{
		display_bit = 1;
	}
	//隐藏多余的位
	if(display_bit<4)
	{
		for( i = 4 ; i > display_bit ; i--)
		{
		if(i ==0)
			decode_one_segment(value_decode_s4[10] ,lcd_ram_buff, start_buff[i-1] );
		else
			decode_one_segment(value_decode[10] ,lcd_ram_buff, start_buff[i-1] );			
		}		
	}
}
/***********************************************************************************************************
* @描述	: 显示4种单位
***********************************************************************************************************/
void display_uint(uint8_t unit)
{
	uint8_t i;
	//清空4个单位
	for( i = 0 ; i < 4 ; i++)
	{
		lcd_ram_buff[i] &= ~(0x0001<<7);
	}
	if(unit <4)
	//显示1个单位
	lcd_ram_buff[unit] |= (0x0001<<7);	
}
/***********************************************************************************************************
* @描述	: 显示小数点 只有3个小数点
***********************************************************************************************************/
void display_dot(uint8_t dot)
{
	uint8_t i;
	
	//清空4个单位
	for( i = 0 ; i < 3 ; i++)
	{
		lcd_ram_buff[0] &= ~(0x0001<<dot_bit[i]);
	}
	if(dot < 3)
	//显示1个单位
	lcd_ram_buff[0] |= (0x0001<<dot_bit[dot]);
	
}
/***********************************************************************************************************
* @描述	: 
***********************************************************************************************************/
void set_temperature_value(uint16_t value)
{
	user_data[0] = value;
}
/***********************************************************************************************************
* @描述	: 
***********************************************************************************************************/
void set_ch4_value(uint16_t value)
{
	user_data[1] = value;
}
/***********************************************************************************************************
* @描述	: 
***********************************************************************************************************/
void set_co_value(uint16_t value)
{
	user_data[2] = value;
}
/***********************************************************************************************************
* @描述	: 
***********************************************************************************************************/
static uint8_t read(uint8_t* stream)
{

	return 0;
}
/***********************************************************************************************************
* @描述	: 
***********************************************************************************************************/
static uint8_t write(uint8_t* stream)
{

	return 0;
}
/***********************************************************************************************************
* @描述	: 
***********************************************************************************************************/
static uint8_t initialization(uint8_t* stream)
{

	lcd_init();
	return 0;
}
/***********************************************************************************************************
* @描述	: 
***********************************************************************************************************/
static uint8_t interrput(uint8_t* stream)
{
	if(delay > 0 )
		delay--;
	return 0;
}
/***********************************************************************************************************
* @描述	: 
***********************************************************************************************************/
static uint8_t run(uint8_t* stream)
{
	static uint16_t diaplay_clk =0;
	if(delay == 0)
	{	
		//更新显示数据	 轮流显示
		display_value(user_data[diaplay_clk%SHOW_NUM]);
		display_uint(user_data_unit[diaplay_clk%SHOW_NUM]);
		display_dot(user_data_dot[diaplay_clk%SHOW_NUM]);
			
		//更新显示
		refresh_lcd_display(lcd_ram_buff);
		
		//延时
		delay=1000;
		diaplay_clk++;
	}	
	return 0;
}
/***********************************************END*********************************************************/
